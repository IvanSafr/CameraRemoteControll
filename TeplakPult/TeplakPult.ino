//////////////////////////////////////////////////////////////////////////////////////////
//                                Код пульта                                            //
//////////////////////////////////////////////////////////////////////////////////////////



/////////////////////////////////////////////
// Лора
/////////////////////////////////////////////
#include <SoftwareSerial.h>
#include "EBYTE22.h"

/////////////////////////////////////////////
//Настройки режима работы

// Введите номер канала от 1 до 65534   Должен быть уникальным! И совпадать у пульта/приемника
unsigned const int ConnectionAdress = 5;
int interval = 500;                     // Частота опроса датчика +

int lastSendTime = 0;

// Константы для Arduino
#define PIN_TX 2
#define PIN_RX 3
#define PIN_M0 4
#define PIN_M1 5
#define PIN_AX 6

SoftwareSerial E22Serial(PIN_TX, PIN_RX, false);  // Создаем объект SoftwareSerial для соединения с модулем через программный UART

EBYTE22 E22(&E22Serial, PIN_M0, PIN_M1, PIN_AX);  // Создаем экземпляр класса EBYTE22

// Структура для передачи через LoRa
struct Data {
  int xAxel = 1500;
  int yAxel = 1500;
} Data;

/////////////////////////////////////////////
// Джойстик
/////////////////////////////////////////////
int joyX = A0;  // ось X джойстика подключена к аналоговому входу A0
int joyY = A1;  // ось X джойстика подключена к аналоговому входу A0

int joyXValue = 0;  // переменная для хранения значения оси X
int joyYValue = 0;  // переменная для хранения значения оси X




//////////////////////////////////////////////////////////////////////////////////////////
//                                    Сетап                                             //
//////////////////////////////////////////////////////////////////////////////////////////
void setup() {
  Serial.begin(9600);                             // Устанавливаем соединение с компьютером (телефоном) для отладки.
  E22Serial.begin(9600);                          // Устанавливаем соединение с модулем (скорость 9600).
  Serial.println("Starting Sender");
  delay(200);

  // При инициализации и некоторых других операциях (применение настроек, установка ключа), модуль переходит в режим конфигурации, в этом режиме UART модуля работает только на скорости 9600!!!
  if (E22.init())                                // Инициализируем модуль(конфигурируются выводы контроллера, считываются настройки модуля).
  {
    Serial.println("init OK");
  } else {
    Serial.println("init Error");
  }                 // Если что-то пошло не так, выводим сообщение об ошибке.

  // В случае ошибки, проверьте правильность подключения и перезапустите модуль с контроллером сбросом питания (кнопка сброса контроллера НЕ ПОМОГАЕТ).

  // Настроим модуль на передачу с указанием адреса.
  E22.setTransmissionMode(TXM_FIXED);             // Режим фиксированной передачи
  E22.writeSettings(TEMPORARY);                   // Применяем настройки временно (до отключения питания)
  delay(200);
  E22.sendTarget(0, 23); // Метод для установки целевого адреса, передает модулю 3 байта данных (2 - адрес и 1 - канал).
}


//////////////////////////////////////////////////////////////////////////////////////////
//                                Основной цикл                                         //
//////////////////////////////////////////////////////////////////////////////////////////
void loop() {
  // Считывание и отправка данных по таймеру
  if (millis() - lastSendTime > interval) {
    int x_speed = 0;
    int y_speed = 0;

    joyXValue = analogRead(joyX);  // считываем значение оси джойстика X
    joyYValue = analogRead(joyY);  // считываем значение оси джойстика Y

    // преобразуем значение оси X в ширину импульса
    x_speed = map(joyXValue, 0, 1023, -10, 13);
    Data.xAxel += x_speed;
    Data.xAxel = constrain(Data.xAxel, 1000, 2000);

    // преобразуем значение оси Y в ширину импульса
    x_speed = map(joyYValue, 0, 1023, -10, 13);
    Data.yAxel += x_speed;
    Data.yAxel = constrain(Data.yAxel, 1000, 2000);

    /////////////////////////////////////////////
    // Вывод для отладки, потом закоментировать
    /////////////////////////////////////////////
    Serial.print("X speed/position");
    Serial.println(x_speed);
    Serial.println(Data.xAxel);

    Serial.print("Y speed/position");
    Serial.println(y_speed);
    Serial.println(Data.yAxel);
    Serial.println("__________________");


    /////////////////////////////////////////////
    // Отправка пакета данных
    /////////////////////////////////////////////
    if (E22.getBusy()) {                            // Если модуль чем-то занят (на выводе AUX логический 0),
      E22.completeTask(100);                        // подождем, пока освободится с таймаутом в 5 секунд.
    }

    E22.sendStruct(&Data, sizeof(Data));
    lastSendTime = millis();
  }
}
